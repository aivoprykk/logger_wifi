## Kconfig
```kconfig
menu "Logger Wifi Module Configuration"
    config WIFI_TASK_STACK_SIZE
        int "Wifi Task stack size in bytes"
        default 3072
    config SNTP_TIME_SERVER
        string "SNTP server name"
        default "ee.pool.ntp.org"
        help
            Hostname of the main SNTP server.
    config SNTP_TIME_ZONE
        int "SNTP time zone"
        default 2
        help
            Time zone in hours.
    choice
        bool "Default log verbosity"
        default LOGGER_WIFI_LOG_LEVEL_WARN
        help
            Specify how important log should be added.
        config LOGGER_WIFI_LOG_LEVEL_TRACE
            bool "A lot of logs to give detailed information"
        config LOGGER_WIFI_LOG_LEVEL_INFO
            bool "Log important events"
        config LOGGER_WIFI_LOG_LEVEL_WARN
            bool "Log if something unwanted happened but didn't cause a problem"
        config LOGGER_WIFI_LOG_LEVEL_ERROR
            bool "Only critical issues, when the system may fail"
        config LOGGER_WIFI_LOG_LEVEL_USER
            bool "Only logs added by the user"
        config LOGGER_WIFI_LOG_LEVEL_NONE
            bool "Do not log anything"
    endchoice
    config LOGGER_WIFI_LOG_LEVEL
        int
        default 0 if LOGGER_WIFI_LOG_LEVEL_TRACE
        default 1 if LOGGER_WIFI_LOG_LEVEL_INFO
        default 2 if LOGGER_WIFI_LOG_LEVEL_WARN
        default 3 if LOGGER_WIFI_LOG_LEVEL_ERROR
        default 4 if LOGGER_WIFI_LOG_LEVEL_USER
        default 5 if LOGGER_WIFI_LOG_LEVEL_NONE
endmenu
```
